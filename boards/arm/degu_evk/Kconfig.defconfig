## boards/arm/degu_evk/Kconfig.defconfig
```kconfig
# Kconfig - Degu Evaluation Kit configuration
#
# Copyright (c) 2019 Atmark Techno, Inc.
#
# SPDX-License-Identifier: Apache-2.0

if BOARD_DEGU_EVK

config BOARD
	default "degu_evk"

if USB

config USB_NRF52840
	def_bool y

config USB_DEVICE_STACK
	def_bool y

endif # USB

if IEEE802154

config IEEE802154_NRF5
	def_bool y

endif # IEEE802154

config I2C
	def_bool y

if I2C

config I2C_NRFX
	def_bool y

if I2C_NRFX

config I2C_0
	def_bool n

config I2C_1
	def_bool y

endif #I2C_NRFX

if I2C_0

choice I2C_0_NRF_TYPE
	default I2C_0_NRF_TWIM

endchoice

endif # I2C_0

if I2C_1

choice I2C_1_NRF_TYPE
	default I2C_1_NRF_TWIM

endchoice

endif # I2C_1

endif # I2C

if ADC

config ADC_NRFX_SAADC
	def_bool y

if ADC_NRFX_SAADC

config ADC_0
	def_bool y

endif # ADC_NRFX_SAADC

endif # ADC

endif # BOARD_DEGU_EVK
```

## drivers/hlse/Kconfig
```kconfig
# Kconfig - Host Library Secure Element configuration options
#
#
# Copyright (c) 2019 Atmark Techno, Inc.
#
# SPDX-License-Identifier: Apache-2.0
#

menuconfig HLSE
	bool "Host Library Secure Element for A71CH"

menuconfig HLSE_MBEDTLS_ALT
	bool "Use alternative cryptography engine for mbed TLS [Experimental]"
	depends on HLSE
```
