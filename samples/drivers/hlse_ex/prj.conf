## CMakeLists.txt
```
cmake_minimum_required(VERSION 3.13.1)
include($ENV{ZEPHYR_BASE}/cmake/app/boilerplate.cmake NO_POLICY_SCOPE)
project(hlse_ex)

FILE(GLOB app_sources src/*.c)
target_sources(app PRIVATE ${app_sources})

add_definitions(
	-DTGT_A71CH
	-DI2C
	-DNO_SECURE_CHANNEL_SUPPORT
	)
```

## sample.yaml
```
sample:
  name: Example for A71CH (HLSE)
tests:
  test:
    platform_whitelist: degu_evk
    tags: drivers
    depends_on: hlse
```

## prj.conf
```kconfig
CONFIG_STDOUT_CONSOLE=y
CONFIG_CONSOLE_HANDLER=y
CONFIG_CONSOLE_SUBSYS=y
CONFIG_CONSOLE_GETCHAR=y
CONFIG_SHELL=y
CONFIG_PRINTK=y
CONFIG_MAIN_STACK_SIZE=2048
CONFIG_SYSTEM_WORKQUEUE_STACK_SIZE=2048
CONFIG_FP_HARDABI=y
CONFIG_FLOAT=y
CONFIG_NEWLIB_LIBC=y
CONFIG_HLSE=y
CONFIG_INIT_STACKS=y
CONFIG_REBOOT=y
CONFIG_MBEDTLS=y
CONFIG_MBEDTLS_TLS_VERSION_1_2=y
CONFIG_MBEDTLS_DTLS=y
CONFIG_MBEDTLS_KEY_EXCHANGE_ALL_ENABLED=y
CONFIG_MBEDTLS_ECP_ALL_ENABLED=y
CONFIG_MBEDTLS_CIPHER_ALL_ENABLED=y
CONFIG_MBEDTLS_MAC_ALL_ENABLED=y
CONFIG_MBEDTLS_CFG_FILE="a71ch_mbedtls_config.h"
CONFIG_ENTROPY_GENERATOR=y

CONFIG_I2C_GPIO=y
CONFIG_I2C_GPIO_0=y
CONFIG_I2C_GPIO_0_NAME="BITBANG_I2C_0"
CONFIG_I2C_GPIO_0_GPIO="GPIO_0"
CONFIG_I2C_GPIO_0_SCL_PIN=22
CONFIG_I2C_GPIO_0_SDA_PIN=20
```

## src/ex_boot.c
```c
/**
 * @file ex_boot.c
 * @author NXP Semiconductors
 * @version 1.0
 * @par License
 * Copyright 2016 NXP
 *
 * This software is owned or controlled by NXP and may only be used
 * strictly in accordance with the applicable license terms.  By expressly
 * accepting such terms or by downloading, installing, activating and/or
 * otherwise using the software, you are agreeing that you have read, and
 * that you agree to comply with and are bound by, such license terms.  If
 * you do not agree to be bound by the applicable license terms, then you
 * may not retain, install, activate or otherwise use the software.
 *
 * @par Description
 * Handover of SCP03 session keys from bootloader to OS. Refer to ::exBoot for more details.
 */

#include <stdio.h>
#include <stdlib.h>
#include <string.h>
#include <assert.h>

#include "a71ch_ex.h"
#include "a71_debug.h"
#include "sm_types.h"
#include "sm_apdu.h"
#include "tst_sm_util.h"
#include "tst_a71ch_util.h"
#include "sm_printf.h"
#include "axHostCrypto.h"
#include "tstHostCrypto.h"
#include "scp.h"
#include "ax_util.h"
#include "app_boot.h"

#if defined(I2C)
#include "sci2c.h"
#endif

/// @cond
static U8 writeStateToFile(char *szFilename, SmCommState_t *commState, Scp03SessionState_t *scp03State);
static U8 readStateFromFile(char *szFilename, SmCommState_t *commState, Scp03SessionState_t *scp03State);

char* axExBootGetBootModeAsString(U8 bootMode)
{
    if (bootMode == BOOT_SKIP_EXAMPLE)
    {
        return "Skip boot example";
    }
    else if (bootMode == BOOT_SIMULATED_CYCLE)
    {
        return "Do full boot cycle (Bootloader/OS combined)";
    }
    else if (bootMode == BOOT_BOOTLOADER_ROLE)
    {
        return "Mimick behaviour of bootloader only (store session state on filesystem)";
    }
    else if (bootMode == BOOT_HOST_OS_RESUME)
    {
        return "Mimick behaviour of Host OS only (retrieve session state from filesystem)";
    }
    else
    {
        PRINTF("bootMode not defined\n");
        assert(0);
        return "not defined";
    }
}

static void signalFunctionCallback(ScpEvent_t event, void *context)
{
    AX_UNUSED_ARG(context);
    PRINTF("scpCallback: ");
    switch (event)
    {
        case SCP_WRONG_PADDING:
            PRINTF("Wrong padding\n");
        break;

        case SCP_WRONG_RESPMAC:
            PRINTF("Wrong response mac\n");
        break;

        case SCP_GENERIC_FAILURE:
            PRINTF("Non specified failure\n");
        break;

        default:
            PRINTF("Unknown event type\n");
        break;
    }
    return;
}
/// @endcond

/**
* This example illustrates that the HostOS does NOT need to know the SCP03 Base Keys
* to establish an SCP03 session (provided the boot loader has established the
* SCP03 session and saved the SCP03 session state)
*
* When using SCI2C the bootloader must also save the SCI2C state.
*
* - The boot loader
*       - Sets an initial SCP03 base key set (based on random data retrieved from
*         the SM (Secure Module))
*       - Establishes an SCP03 session
*       - Stores the SCP03 session (optionally also SCI2C state)
*
* - The OS
*       - Retrieves the SCP03 session and communication state
*       - Resumes the SCP03 session
*
* \note When the OS takes over from the boot loader the communication link with
*    the Secure Element may not be broken.
* \note Storing the session and communication state on the filesystem is done for convenience
*    in this example. Use an appropriate and secure sharing mechanism in a product implementation.
* \note Full functionality of this example is only available when connecting to the A71CH over SCI2C.
* @param[in] bootMode One of the following values
*   - ::BOOT_SIMULATED_CYCLE Can be used to simulate handover of session keys (no dependency on link protocol)
*   - ::BOOT_BOOTLOADER_ROLE Play the role of initial bootloader and store session and communication state to filesystem
*   - ::BOOT_HOST_OS_RESUME  Play the role of OS and retrieve session and communication state from the filesystem
*/
U8 exBoot(U8 bootMode)
{
    U8 result = 1;
    U8 initMode = INIT_MODE_NO_RESET;

    U8 scpKeyEncBase[SCP_KEY_SIZE];
    U8 scpKeyMacBase[SCP_KEY_SIZE];
    U8 scpKeyDekBase[SCP_KEY_SIZE];

    U8 dataRef[] = {0xBE, 0xFA, 0x02, 0x03, 0x04, 0x05, 0x06, 0x07};
    U16 dataRefLen = sizeof(dataRef);
    U8 dataFetch[8];
    U16 packetSize;

    U16 connectStatus;
    U8 Atr[64];
    U16 AtrLen = sizeof(Atr);

    SmCommState_t commState;
    Scp03SessionState_t sessionState;

    U16 sw = SW_OK;
#if defined(I2C)
    char szFilename[] = "sessionState";
#endif

    PRINTF("\n-----------\nStart exBoot(%s)\n------------\n", axExBootGetBootModeAsString(bootMode));

    if (bootMode == BOOT_SKIP_EXAMPLE)
    {
        PRINTF("***** WARNING: exBoot example is skipped *****\n");
    }
    else if (bootMode == BOOT_SIMULATED_CYCLE)
    {
        initMode = INIT_MODE_RESET;

        // Installing Callback (this step is optional)
        SCP_Subscribe(signalFunctionCallback, NULL);
        DEV_ClearChannelState();
#if defined(I2C)
        SM_Close(SMCOM_CLOSE_MODE_TERMINATE);
#endif
        connectStatus = SM_Connect(&commState, Atr, &AtrLen);
        if (connectStatus != SW_OK)
        {
            sm_printf(CONSOLE, "Failed to establish connection to Secure Module: 0x%04X\n", connectStatus);
            result = 0;
            return result;
        }
        else
        {
#ifndef RJCT_SOCKET
            int i=0;
            sm_printf(CONSOLE, "ATR=0x");
            for (i=0; i<AtrLen; i++) sm_printf(CONSOLE, "%02X.", Atr[i]);
            sm_printf(CONSOLE, "\n");
#endif
        }

        // STAGE-0:
        // - Force the A71CH into the initial state (only possible when in Debug Mode)
        sm_printf(CONSOLE, "Initialize Module\n");
        result &= a71chInitModule(initMode);

        // STAGE-1:
        // - Fetch random data from the A71CH
        // - Set the SCP03 keys based on this random data
        // - This binding between Host and A71CH must only be done once
        result &= axExCreateAndSetInitialHostScpKeys(scpKeyEncBase, scpKeyMacBase, scpKeyDekBase);

        // STAGE-2:
        // - Locally store the SCP03 base keys on the Host (for re-use in the next boot cycle)
        // - Set up the authenticated and encrypted SCP03 channel with the A71CH.
        result &= axExAuthenticate(scpKeyEncBase, scpKeyMacBase, scpKeyDekBase);

        // STAGE-3:
        // - Write an 8 byte pattern to GPStorage (just using some standard A71CH functionality)
        packetSize = dataRefLen;
        PRINTF( "\nA71_SetGpData(0, %d, ...)\n", packetSize);
        sw = A71_SetGpData(0, dataRef, packetSize);
        result &= AX_CHECK_SW(sw, SW_OK, "A71_SetGpData fails");

        // Before Handing over to the Host OS:
        // - Retrieve and store the SCP03 session state
        // - Retrieve and store SCI2C communication state
        SCP_GetScpSessionState(&sessionState);
        // At this stage the System Integrator must store Session State in Mailbox for HostOS
#if defined(I2C)
        commState.param1 = sci2c_GetSequenceCounter();
        // At this stage the System Integrator must store communication state in Mailbox for HostOS
        SM_Close(SMCOM_CLOSE_MODE_STD);
#endif
        sm_printf(DBGOUT, "\n\n");
        sm_printf(DBGOUT, "******************************************************************\n");
        sm_printf(DBGOUT, "** System Integrator must store Communication and Session State **\n");
        sm_printf(DBGOUT, "******************************************************************\n");

        DEV_ClearChannelState();

        // +++ Handover from Boot to HostOS +++

        // ** Host OS phase **
        SM_ResumeConnection(&commState, &sessionState);

        // - Retrieve and compare the 8 byte reference pattern from GPStorage (just using some standard A71CH functionality)
        packetSize = dataRefLen;
        PRINTF( "\nA71_GetGpData(0, %d, ...)\n", packetSize);
        sw = A71_GetGpData(0, dataFetch, packetSize);
        result &= AX_CHECK_SW(sw, SW_OK, "A71_GetGpData fails");
        axPrintByteArray ("dataFetch", dataFetch, packetSize, AX_COLON_32);
        result &= AX_COMPARE_BYTE_ARRAY("dataRef", dataRef, dataRefLen,
            "dataFetch", dataFetch, dataRefLen, AX_COLON_32);
    }
#if defined(I2C)
    else if (bootMode == BOOT_BOOTLOADER_ROLE)
    {
        initMode = INIT_MODE_RESET;

        // Installing Callback (this step is optional)
        SCP_Subscribe(signalFunctionCallback, NULL);
        DEV_ClearChannelState();
        SM_Close(SMCOM_CLOSE_MODE_TERMINATE);
        connectStatus = SM_Connect(&commState, Atr, &AtrLen);
        if (connectStatus != SW_OK)
        {
            sm_printf(CONSOLE, "Failed to establish connection to Secure Module: 0x%04X\n", connectStatus);
            result = 0;
            return result;
        }
        else
        {
            int i=0;
            sm_printf(CONSOLE, "ATR=0x");
            for (i=0; i<AtrLen; i++) sm_printf(CONSOLE, "%02X.", Atr[i]);
            sm_printf(CONSOLE, "\n");
        }

        // STAGE-0:
        // - Force the A71CH into the initial state (only possible when in Debug Mode)
        sm_printf(CONSOLE, "Initialize Module\n");
        result &= a71chInitModule(initMode);

        // STAGE-1:
        // - Fetch random data from the A71CH
        // - Set the SCP03 keys based on this random data
        result &= axExCreateAndSetInitialHostScpKeys(scpKeyEncBase, scpKeyMacBase, scpKeyDekBase);

        // STAGE-2:
        // - Locally store the SCP03 base keys
        // - Set up the authenticated and encrypted SCP03 channel with the A71CH.
        result &= axExAuthenticate(scpKeyEncBase, scpKeyMacBase, scpKeyDekBase);

        // STAGE-3:
        // - Write an 8 byte pattern to GPStorage (just using some standard A71CH functionality)
        packetSize = dataRefLen;
        PRINTF( "\nA71_SetGpData(0, %d, ...)\n", packetSize);
        sw = A71_SetGpData(0, dataRef, packetSize);
        result &= AX_CHECK_SW(sw, SW_OK, "A71_SetGpData fails");

        // Before Handing over to the Host OS:
        // - Retrieve and store the SCP03 session state
        // - Retrieve and store SCI2C communication state
        SCP_GetScpSessionState(&sessionState);
        commState.param1 = sci2c_GetSequenceCounter();

        SM_Close(SMCOM_CLOSE_MODE_STD);

        sm_printf(DBGOUT, "\n\n");
        sm_printf(DBGOUT, "******************************************************************\n");
        sm_printf(DBGOUT, "** System Integrator must store Communication and Session State **\n");
        sm_printf(DBGOUT, "******************************************************************\n");
        sm_printf(DBGOUT, "..\n..\n");

        // WARNING: Simply writing the SessionState to the file system is not a secure implementation.
        // it must not be used in products.
        writeStateToFile(szFilename, &commState, &sessionState);

        DEV_ClearChannelState();

    }
    else if (bootMode == BOOT_HOST_OS_RESUME)
    {
        SmCommState_t retrCommState;
        Scp03SessionState_t retrScp03State;

        readStateFromFile(szFilename, &retrCommState, &retrScp03State);
        PRINTF("retrCommState.param1         : 0x%04X\n", retrCommState.param1);
        PRINTF("retrCommState.hostLibVersion : 0x%04X\n", retrCommState.hostLibVersion);
        PRINTF("retrCommState.appletVersion  : 0x%04X\n", retrCommState.appletVersion);

        DEV_ClearChannelState();

        // +++ Handover from Boot to HostOS +++

        sm_printf(DBGOUT, "\n\n");
        sm_printf(DBGOUT, "*******************************************************\n");
        sm_printf(DBGOUT, "** Host OS resumes SCP03 session with Secure Element **\n");
        sm_printf(DBGOUT, "*******************************************************\n");
        // ** Host OS phase **
        SM_ResumeConnection(&retrCommState, &retrScp03State);

        // - Retrieve and compare the 8 byte reference pattern from GPStorage (just using some standard A71CH functionality)
        packetSize = dataRefLen;
        PRINTF( "\nA71_GetGpData(0, %d, ...)\n", packetSize);
        sw = A71_GetGpData(0, dataFetch, packetSize);
        result &= AX_CHECK_SW(sw, SW_OK, "A71_GetGpData fails");
        axPrintByteArray ("dataFetch", dataFetch, packetSize, AX_COLON_32);

        result &= AX_COMPARE_BYTE_ARRAY("dataRef", dataRef, dataRefLen,
            "dataFetch", dataFetch, dataRefLen, AX_COLON_32);
    }
#endif // defined(I2C)
    else
    {
        PRINTF("bootMode (0x%02X) is not defined.\n", bootMode);
        result = 0;
    }

    // overall result
    PRINTF("\n-----------\nEnd exBoot(%s), result = %s\n------------\n",
        axExBootGetBootModeAsString(bootMode), ((result == 1)? "OK": "FAILED"));

    return result;
}

/**
 * The host fetches random data from the A71CH and sets these as SCP03 base keys in the
 * A71CH.
 *
 * @param[in,out] keyEnc IN: Buffer to contain key; OUT: Key created and inserted into A71CH
 * @param[in,out] keyMac IN: Buffer to contain key; OUT: Key created and inserted into A71CH
 * @param[in,out] keyDek IN: Buffer to contain key; OUT: Key created and inserted into A71CH
 */
U8 axExCreateAndSetInitialHostScpKeys(U8 *keyEnc, U8 *keyMac, U8 *keyDek)
{
    U8 result = 1;
    U16 err = 0;
    U8 random[3*SCP_KEY_SIZE];
    U8 randomLen = (U8)sizeof(random);
    U8 *currentKeyDek = NULL;
    U8 keyVersion = 1;

    assert(keyEnc != NULL);
    assert(keyMac != NULL);
    assert(keyDek != NULL);

    PRINTF( "\n-----------\nStart axExCreateAndSetInitialHostScpKeys()\n------------\n");

    // Security module generates random data for initial SCP03 keys
    sm_printf(CONSOLE, "\nA71_GetRandom(randomLen=%d)\n", randomLen);
    err = A71_GetRandom(random, randomLen);
    result &= AX_CHECK_SW(err, SW_OK, "err");

    // Storing Static Keys
    memcpy(keyEnc, random, SCP_KEY_SIZE);
    memcpy(keyMac, random + SCP_KEY_SIZE, SCP_KEY_SIZE);
    memcpy(keyDek, random + (2*SCP_KEY_SIZE), SCP_KEY_SIZE);

    keyVersion = (U8) (SST_HOST_SCP_KEYSET >> 8);
    sm_printf(CONSOLE, "\nSCP_GP_PutKeys(keyVersion=0x%02X)\n", keyVersion);
    err = SCP_GP_PutKeys(keyVersion, keyEnc, keyMac, keyDek, currentKeyDek, AES_KEY_LEN_nBYTE);
    result &= AX_CHECK_SW(err, SW_OK, "err");

    PRINTF( "\n-----------\nEnd axExCreateAndSetInitialHostScpKeys(), result = %s\n------------\n",
        ((result == 1)? "OK": "FAILED"));

    return result;
}

/**
 * The host locally stores the SCP03 base keys passed as parameters and establishes
 * the authenticated and encrypted SCP03 channel with the A71CH.
 *
 * @param[in] keyEnc IN: SCP03 base key
 * @param[in] keyMac IN: SCP03 base key
 * @param[in] keyDek IN: SCP03 base key
 */
U8 axExAuthenticate(U8 *keyEnc, U8 *keyMac, U8 *keyDek)
{
    U8 sCounter[3];
    U16 sCounterLen = sizeof(sCounter);

    U8 result = 1;
    U16 err = 0;

    PRINTF( "\n-----------\nStart axExAuthenticate()\n------------\n");

    // Authenticate Channel
    sm_printf(CONSOLE, "\nSCP_Authenticate()\n");
    err = SCP_Authenticate(keyEnc, keyMac, keyDek, SCP_KEY_SIZE, sCounter, &sCounterLen);
    result &= AX_CHECK_SW(err, SW_OK, "err");
    result &= AX_CHECK_U16(sCounterLen, 0, "Only expected when SCP03 is configured for pseudo-random challenge");

    PRINTF( "\n-----------\nEnd axExAuthenticate(), result = %s\n------------\n",
        ((result == 1)? "OK": "FAILED"));

    return result;
}

/// @cond
static U8 writeStateToFile(char *szFilename, SmCommState_t *commState, Scp03SessionState_t *scp03State)
{
    U8 result = 1;
#ifdef FTR_FILE_SYSTEM
    FILE *fHandle = NULL;

    fHandle = fopen(szFilename, "w");

    if (fHandle == NULL)
    {
        sm_printf(DBGOUT, "Failed to open file %s for writing\n", szFilename);
        return 0;
    }

    fwrite((const void *) commState, sizeof(SmCommState_t), 1, fHandle);
    fwrite((const void *) scp03State, sizeof(Scp03SessionState_t), 1, fHandle);

    fclose(fHandle);
#endif
    return result;
}

static U8 readStateFromFile(char *szFilename, SmCommState_t *commState, Scp03SessionState_t *scp03State)
{
    U8 result = 1;
#ifdef FTR_FILE_SYSTEM
    FILE *fHandle = NULL;

    fHandle = fopen(szFilename, "r");

    if (fHandle == NULL)
    {
        sm_printf(DBGOUT, "Failed to open file %s for reading", szFilename);
        return 0;
    }

    fread((void *) commState, sizeof(SmCommState_t), 1, fHandle);
    fread((void *) scp03State, sizeof(Scp03SessionState_t), 1, fHandle);

    fclose(fHandle);
#endif
    return result;
}
/// @endcond
```

## src/ex_config.c
```c
/**
 * @file ex_config.c
 * @author NXP Semiconductors
 * @version 1.0
 * @par License
 * Copyright 2017 NXP
 *
 * This software is owned or controlled by NXP and may only be used
 * strictly in accordance with the applicable license terms.  By expressly
 * accepting such terms or by downloading, installing, activating and/or
 * otherwise using the software, you are agreeing that you have read, and
 * that you agree to comply with and are bound by, such license terms.  If
 * you do not agree to be bound by the applicable license terms, then you
 * may not retain, install, activate or otherwise use the software.
 *
 * @par Description
 * Example invocation of configure key specific functionality of the A71CH
 */

#include <stdio.h>
#include <stdlib.h>
#include <string.h>
#include <assert.h>

#include "a71ch_ex.h"
#include "a71_debug.h"
#include "sm_types.h"
#include "sm_apdu.h"
#include "ax_util.h"
#include "tst_sm_util.h"
#include "tst_a71ch_util.h"
#include "axHostCrypto.h"
#include "tstHostCrypto.h"
#include "HostCryptoAPI.h"
static U8 exSetConfigKey(U8 initMode);
static U8 exSstPubEnc(U8 initMode);
static U8 exSstPubEraseAfterInjectLock(void);
static U8 exSstKeyPairEnc(U8 initMode, U16 appletVersion);

static U8 configKeyModuleLock[16];  //!< Configuration Key for Module, acting as transport key (index ::A71CH_CFG_KEY_IDX_MODULE_LOCK)
static U8 configKeyPrivateKey[16];  //!< Configuration Key for Private Key encryption (index ::A71CH_CFG_KEY_IDX_PRIVATE_KEYS)
static U8 configKeyPublicKey[16];   //!< Configuration Key for Public Key encryption (index ::A71CH_CFG_KEY_IDX_PUBLIC_KEYS)

#define EX_CONFIG_DEMO_LOCK_UNLOCK
#ifndef NO_SECURE_CHANNEL_SUPPORT
#define EX_CONFIG_ALSO_USE_SCP03
#endif

/**
 * Demonstrate storage and usage of config keys:
 * - ::exSetConfigKey
 * - ::exSstPubEnc
 * - ::exSstKeyPairEnc
 * - ::exSstPubEraseAfterInjectLock
 *
 */
U8 exConfig(U16 appletVersion)
{
    U8 result = 1;
    int i = 0;
    PRINTF( "\n-----------\nStart exConfig()\n------------\n");

    DEV_ClearChannelState();

    // Choose a (unique) pattern for each config key
    for (i=0; i<16; i++) {
        configKeyModuleLock[i] = (U8)(i ^ A71CH_CFG_KEY_IDX_MODULE_LOCK);
        configKeyPrivateKey[i] = (U8)(i ^ A71CH_CFG_KEY_IDX_PRIVATE_KEYS);
        configKeyPublicKey[i] = (U8)(i ^ A71CH_CFG_KEY_IDX_PUBLIC_KEYS);
    }

    // No channel encryption
    // ---------------------
    // - First set the config keys
    result &= exSetConfigKey(INIT_MODE_RESET);

    // - Set wrapped Public keys
    result &= exSstPubEnc(INIT_MODE_NO_RESET);
    // - Set wrapped key pairs (only private key is wrapped)
    result &= exSstKeyPairEnc(INIT_MODE_NO_RESET, appletVersion);
    // - Check on erasing Public keys after Module Inject Lock has been set
    result &= exSstPubEraseAfterInjectLock();

#ifdef EX_CONFIG_ALSO_USE_SCP03
    // Using channel encryption
    // ------------------------
    // - First set the config keysSym keys
    result &= exSetConfigKey(INIT_MODE_RESET_DO_SCP03);

    // - Set wrapped Public keys
    result &= exSstPubEnc(INIT_MODE_NO_RESET);

    // - Set wrapped key pairs (only private key is wrapped)
    result &= exSstKeyPairEnc(INIT_MODE_NO_RESET, appletVersion);

    // - Check on erasing Public keys after Module Inject Lock has been set
    result &= exSstPubEraseAfterInjectLock();
#endif

    // overall result
    PRINTF( "\n-----------\nEnd exConfig(), result = %s\n------------\n", ((result == 1)? "OK": "FAILED"));

    return result;
}

/**
 * Demonstrate
 * - setting config keys
 * - use of transport key (config key at index ::A71CH_CFG_KEY_IDX_MODULE_LOCK) to lock/unlock A71CH
 *
 * @param[in] initMode Visit the documentation of ::a71chInitModule for more information on this parameter
 */
static U8 exSetConfigKey(U8 initMode)
{
    U8 result = 1;
    U16 err;

    U8 uid[A71CH_MODULE_UNIQUE_ID_LEN];
    U16 uidLen = sizeof(uid);

    U8 challenge[A71CH_MODULE_UNLOCK_CHALLENGE_LEN];
    U16 challengeLen = sizeof(challenge);

    U8 unlockCode[A71CH_MODULE_UNLOCK_CHALLENGE_LEN];
    S32 hcRet = 0;

    U8 indexCfgKey = A71CH_CFG_KEY_IDX_MODULE_LOCK;

    PRINTF("\n-----------\nStart exSetConfigKey(%s)\n------------\n", getInitModeAsString(initMode));
    // Initialize the A71CH (Debug mode restrictions may apply)
    result &= a71chInitModule(initMode);

    // Store all configure keys (value is stored in variables with module scope)
    indexCfgKey = A71CH_CFG_KEY_IDX_MODULE_LOCK;
    PRINTF("\nA71_SetConfigKey(0x%02x)\n", indexCfgKey);
    err = A71_SetConfigKey((SST_Index_t)indexCfgKey, configKeyModuleLock, sizeof(configKeyModuleLock));
    result &= AX_CHECK_SW(err, SW_OK, "err");
    axPrintByteArray("configKeyModuleLock", configKeyModuleLock, sizeof(configKeyModuleLock), AX_COLON_32);

    indexCfgKey = A71CH_CFG_KEY_IDX_PRIVATE_KEYS;
    PRINTF("\nA71_SetConfigKey(0x%02x)\n", indexCfgKey);
    err = A71_SetConfigKey((SST_Index_t)indexCfgKey, configKeyPrivateKey, sizeof(configKeyPrivateKey));
    result &= AX_CHECK_SW(err, SW_OK, "err");
    axPrintByteArray("configKeyPrivateKey", configKeyPrivateKey, sizeof(configKeyPrivateKey), AX_COLON_32);

    indexCfgKey = A71CH_CFG_KEY_IDX_PUBLIC_KEYS;
    PRINTF("\nA71_SetConfigKey(0x%02x)\n", indexCfgKey);
    err = A71_SetConfigKey((SST_Index_t)indexCfgKey, configKeyPublicKey, sizeof(configKeyPublicKey));
    result &= AX_CHECK_SW(err, SW_OK, "err");
    axPrintByteArray("configKeyPublicKey", configKeyPublicKey, sizeof(configKeyPublicKey), AX_COLON_32);

#ifdef EX_CONFIG_DEMO_LOCK_UNLOCK
    // Lock device for transport
    PRINTF("\nA71_LockModule()\n");
    err = A71_LockModule();
    result &= AX_CHECK_SW(err, SW_OK, "err");

    PRINTF("\nA71_GetUniqueID().\n");
    err = A71_GetUniqueID(uid, &uidLen);
    result &= AX_CHECK_SW(err, SW_OK, "err");
    axPrintByteArray("uid", uid, uidLen, AX_COLON_32);

    PRINTF("\nA71_GetUnlockChallenge().\n");
    err = A71_GetUnlockChallenge(challenge, &challengeLen);
    result &= AX_CHECK_SW(err, SW_OK, "err");
    axPrintByteArray("challenge", challenge, challengeLen, AX_COLON_32);

    // Decrypt challenge
    hcRet = HOST_AES_ECB_DECRYPT(unlockCode, challenge, configKeyModuleLock, sizeof(configKeyModuleLock));
    if (hcRet != HOST_CRYPTO_OK)
    {
        PRINTF("HOST_AES_ECB_DECRYPT: failed.\n");
        result = 0;
    }

    PRINTF("\nA71_UnlockModule()\n");
    err = A71_UnlockModule(unlockCode, 16);
    result &= AX_CHECK_SW(err, SW_OK, "err");
#endif

    PRINTF( "\n-----------\nEnd exSetConfigKey(%s), result = %s\n------------\n", getInitModeAsString(initMode), ((result == 1)? "OK": "FAILED"));

    return result;
}

/**
 * Demonstrate
 * - setting a wrapped public key
 * - demonstrate key can be used through verify operation
 *
 * @param[in] initMode Visit the documentation of ::a71chInitModule for more information on this parameter
 */
static U8 exSstPubEnc(U8 initMode)
{
    U8 result = 1;
    U16 err;
    int i;

    ECCCurve_t eccCurve = ECCCurve_NIST_P256;

    EC_KEY *eccKeyCA[A71CH_PUBLIC_KEY_MAX];
    eccKeyComponents_t eccKcCA[A71CH_PUBLIC_KEY_MAX];

    U8 fetchedPubKey[65];
    U16 fetchedPubKeyLen = sizeof(fetchedPubKey);

    // const U16 expectedPubKeyLen = 65;
    const U16 expectedPrivKeyLen = 32;

    PRINTF("\n-----------\nStart exSstPubEnc(%s)\n------------\n", getInitModeAsString(initMode));

    // Initialize the A71CH (Debug mode restrictions may apply)
    result &= a71chInitModule(initMode);

    // Start by creating, inserting and checking keys
    for (i=0; i<A71CH_PUBLIC_KEY_MAX; i++)
    {
        U8 wrappedKey[64+8];
        U16 wrappedKeyLen = sizeof(wrappedKey);
        eccKeyCA[i] = NULL;
        err = HOSTCRYPTO_GenerateEccKey(eccCurve, &eccKeyCA[i]);
        result &= AX_CHECK_SW(err, SW_OK, "err");

        err = HOSTCRYPTO_GetPublicKey(eccKeyCA[i], eccKcCA[i].pub, &(eccKcCA[i].pubLen), (64 << 1)+1);
        result &= AX_CHECK_SW(err, SW_OK, "err");

        err = HOSTCRYPTO_GetPrivateKey(eccKeyCA[i], eccKcCA[i].priv, &(eccKcCA[i].privLen), 64);
        result &= AX_CHECK_SW(err, SW_OK, "err");
        eccKcCA[i].bits = expectedPrivKeyLen << 3;
        eccKcCA[i].curve = eccCurve;

        // Wrap public key (strip first character before wrapping) on host
        PRINTF("\nHOSTCRYPTO_AesWrapKeyRFC3394(0x%02X)\n", (SST_Index_t)i);
        err = HOSTCRYPTO_AesWrapKeyRFC3394(configKeyPublicKey, sizeof(configKeyPublicKey),
            wrappedKey, &wrappedKeyLen, &(eccKcCA[i].pub[1]), eccKcCA[i].pubLen - 1);
        result &= AX_CHECK_SW(err, SW_OK, "err");
        axPrintByteArray("wrappedKey", wrappedKey, wrappedKeyLen, AX_COLON_32);

        PRINTF( "\nA71_SetEccPublicKey(0x%02X)\n", (SST_Index_t)i);
        err = A71_SetEccPublicKey ((SST_Index_t) i, wrappedKey, wrappedKeyLen);
        result &= AX_CHECK_SW(err, SW_OK, "err");
    }

    // Read out and verify public key
    for (i=0; i<A71CH_PUBLIC_KEY_MAX; i++)
    {
        PRINTF( "\nA71_GetEccPublicKey(0x%02X)\n", (SST_Index_t)i);
        fetchedPubKeyLen = sizeof(fetchedPubKey);
        err = A71_GetEccPublicKey ((SST_Index_t) i, fetchedPubKey, &fetchedPubKeyLen);
        result &= AX_CHECK_SW(err, SW_OK, "err");

        // Compare with reference value
        result &= AX_COMPARE_BYTE_ARRAY("eccKcCA[i].pub", eccKcCA[i].pub, eccKcCA[i].pubLen,
            "fetchedPubKey", fetchedPubKey, fetchedPubKeyLen, AX_COLON_32);
    }

    for (i=0; i<A71CH_PUBLIC_KEY_MAX; i++)
    {
        HOSTCRYPTO_FreeEccKey(&eccKeyCA[i]);
    }

    PRINTF( "\n-----------\nEnd exSstPubEnc(%s), result = %s\n------------\n", getInitModeAsString(initMode),
        ((result == 1)? "OK": "FAILED"));

    return result;
}

/**
 * Demonstrate
 * - Once the module Inject Lock has been set, its only possible to erase a public key
 *   through a challenge response protocol
 *
 */
static U8 exSstPubEraseAfterInjectLock()
{
    U8 result = 1;
    U16 err;
    int i;

    // ECCCurve_t eccCurve = ECCCurve_NIST_P256;

    // EC_KEY *eccKeyCA[A71CH_PUBLIC_KEY_MAX];
    // eccKeyComponents_t eccKcCA[A71CH_PUBLIC_KEY_MAX];

    U8 fetchedPubKey[65];
    U16 fetchedPubKeyLen = sizeof(fetchedPubKey);

    // const U16 expectedPubKeyLen = 65;
    // const U16 expectedPrivKeyLen = 32;

    PRINTF("\n-----------\nStart exSstPubEraseAfterInjectLock()\n------------\n");

    // Check whether ErasePublicKey - without challenge/response - fails
    for (i=0; i<A71CH_PUBLIC_KEY_MAX; i++)
    {
        PRINTF( "\nA71_EraseEccPublicKey(0x%02X)\n", (SST_Index_t)i);
        err = A71_EraseEccPublicKey((SST_Index_t) i);
        result &= AX_CHECK_SW(err, SW_WRONG_DATA, "err");
    }

    // Confirm reading out public key is still possible
    for (i=0; i<A71CH_PUBLIC_KEY_MAX; i++)
    {
        PRINTF("\nA71_GetEccPublicKey (index=0x%02X)\n", i);
        fetchedPubKeyLen = sizeof(fetchedPubKey);
        err = A71_GetEccPublicKey ((SST_Index_t)i, fetchedPubKey, &fetchedPubKeyLen);
        result &= AX_CHECK_SW(err, SW_OK, "Failed to retrieve Public Ecc Key");
    }

    // Do a ErasePublicKey with challenge response
    for (i=0; i<A71CH_PUBLIC_KEY_MAX; i++)
    {
        PRINTF( "\nA71_EraseEccPublicKeyWithChallenge(0x%02X)\n", (SST_Index_t)i);
        err = A71_EraseEccPublicKeyWithChallenge((SST_Index_t) i, configKeyPublicKey, sizeof(configKeyPublicKey));
        result &= AX_CHECK_SW(err, SW_OK, "err");
    }

    // Check whether reading out (erased) public key now fails.
    for (i=0; i<A71CH_PUBLIC_KEY_MAX; i++)
    {
        PRINTF("\nA71_GetEccPublicKey (index=0x%02X)\n", i);
        fetchedPubKeyLen = sizeof(fetchedPubKey);
        err = A71_GetEccPublicKey ((SST_Index_t)i, fetchedPubKey, &fetchedPubKeyLen);
        result &= AX_CHECK_SW(err, SW_CONDITIONS_NOT_SATISFIED, "Get Public Ecc Key was supposed to fail");
    }

    PRINTF( "\n-----------\nEnd exSstPubEraseAfterInjectLock(), result = %s\n------------\n",
        ((result == 1)? "OK": "FAILED"));

    return result;
}

/**
 * Demonstrate
 * - setting (encrypted)/getting/erasing of key pairs
 * - demonstrate key can be used through sign operations
 * - demonstrate a plain key pair can not be inserted once 'inject lock' has been enabled
 * - demonstrate a keywrapped key pair can still be inserted
 * - demonstrate generating a key pair is conditional on a correct challenge/response
 *
 * @param[in] initMode Visit the documentation of ::a71chInitModule for more information on this parameter
 * @param[in] appletVersion See #SmCommState_t::appletVersion
 */
static U8 exSstKeyPairEnc(U8 initMode, U16 appletVersion)
{
    U8 result = 1;
    U16 err;
    int i;
    HLSE_RET_CODE retcode;

    ECCCurve_t eccCurve = ECCCurve_NIST_P256;

    EC_KEY *eccKeyTls[A71CH_KEY_PAIR_MAX];
    eccKeyComponents_t eccKcTls[A71CH_KEY_PAIR_MAX];

    EC_KEY *eccKeyAlt = NULL;
    eccKeyComponents_t eccKcAlt;

    U8 fetchedPubKey[65];
    U16 fetchedPubKeyLen = sizeof(fetchedPubKey);

    U8 hashSha256[32];
    U16 hashSha256Len = sizeof(hashSha256);

    U8 signature[128];
    U16 signatureLen = sizeof(signature);
    HLSE_MECHANISM_INFO mechInfo;

    // const U16 expectedPubKeyLen = 65;
    const U16 expectedPrivKeyLen = 32;

    U8 wrappedPrivKey[32+8];
    U16 wrappedPrivKeyLen = sizeof(wrappedPrivKey);

    SST_Index_t kpIndex;

    PRINTF("\n-----------\nStart exSstKeyPairEnc(%s)\n------------\n", getInitModeAsString(initMode));

    // Initialize the A71CH (Debug mode restrictions may apply)
    result &= a71chInitModule(initMode);

    // Start by creating, inserting and checking keys
    for (i=0; i<A71CH_KEY_PAIR_MAX; i++)
    {
        eccKeyTls[i] = NULL;
        err = HOSTCRYPTO_GenerateEccKey(eccCurve, &eccKeyTls[i]);
        result &= AX_CHECK_SW(err, SW_OK, "err");

        err = HOSTCRYPTO_GetPublicKey(eccKeyTls[i], eccKcTls[i].pub, &(eccKcTls[i].pubLen), (64 << 1)+1);
        result &= AX_CHECK_SW(err, SW_OK, "err");

        err = HOSTCRYPTO_GetPrivateKey(eccKeyTls[i], eccKcTls[i].priv, &(eccKcTls[i].privLen), 64);
        result &= AX_CHECK_SW(err, SW_OK, "err");
        eccKcTls[i].bits = expectedPrivKeyLen << 3;
        eccKcTls[i].curve = eccCurve;

        // Wrap private key on host
        wrappedPrivKeyLen = sizeof(wrappedPrivKey);
        PRINTF("\nHOSTCRYPTO_AesWrapKeyRFC3394(0x%02X)\n", (SST_Index_t)i);
        err = HOSTCRYPTO_AesWrapKeyRFC3394(configKeyPrivateKey, sizeof(configKeyPrivateKey),
            wrappedPrivKey, &wrappedPrivKeyLen, eccKcTls[i].priv, eccKcTls[i].privLen);
        result &= AX_CHECK_SW(err, SW_OK, "err");
        axPrintByteArray("wrappedPrivKey", wrappedPrivKey, wrappedPrivKeyLen, AX_COLON_32);

        PRINTF( "\nA71_SetEccKeyPair(0x%02X)\n", (SST_Index_t)i);
        err = A71_SetEccKeyPair((SST_Index_t) i, eccKcTls[i].pub, eccKcTls[i].pubLen,
            wrappedPrivKey, wrappedPrivKeyLen);
        result &= AX_CHECK_SW(err, SW_OK, "err");
    }

    // Read out and verify public key
    for (i=0; i<A71CH_KEY_PAIR_MAX; i++)
    {
        PRINTF( "\nA71_GetPublicKeyEccKeyPair (0x%02X)\n", (SST_Index_t)i);
        fetchedPubKeyLen = sizeof(fetchedPubKey);
        err = A71_GetPublicKeyEccKeyPair  ((SST_Index_t) i, fetchedPubKey, &fetchedPubKeyLen);
        result &= AX_CHECK_SW(err, SW_OK, "err");

        // Compare with reference value
        result &= AX_COMPARE_BYTE_ARRAY("eccKcTls[i].pub", eccKcTls[i].pub, eccKcTls[i].pubLen,
            "fetchedPubKey", fetchedPubKey, fetchedPubKeyLen, AX_COLON_32);
    }

    // Create alternative key
    err = HOSTCRYPTO_GenerateEccKey(eccCurve, &eccKeyAlt);
    result &= AX_CHECK_SW(err, SW_OK, "err");

    err = HOSTCRYPTO_GetPublicKey(eccKeyAlt, eccKcAlt.pub, &(eccKcAlt.pubLen), (64 << 1)+1);
    result &= AX_CHECK_SW(err, SW_OK, "err");

    err = HOSTCRYPTO_GetPrivateKey(eccKeyAlt, eccKcAlt.priv, &(eccKcAlt.privLen), 64);
    result &= AX_CHECK_SW(err, SW_OK, "err");
    eccKcAlt.bits = expectedPrivKeyLen << 3;
    eccKcAlt.curve = eccCurve;
    HOSTCRYPTO_FreeEccKey(&eccKeyAlt);

    // Fill up the hash with some reference data
    hashSha256Len = sizeof(hashSha256);
    for (i=0; i<hashSha256Len; i++) { hashSha256[i] = (U8)i; }

    // Sign a hash of correct length on the A71CH and do the verification on the Host
    for (i=0; i<A71CH_KEY_PAIR_MAX; i++)
    {
        signatureLen = sizeof(signature);
        if (appletVersion >= 0x0130)
        {
            PRINTF("\nA71_EccSign(0x%02X)\n", (SST_Index_t)i);
            err = A71_EccSign((SST_Index_t)i, hashSha256, hashSha256Len, signature, &signatureLen);
        }
        else
        {
            PRINTF("\nA71_EccSign(0x%02X)\n", (SST_Index_t)i);
            err = A71_EccSign((SST_Index_t)i, hashSha256, hashSha256Len, signature, &signatureLen);
        }
        result &= AX_CHECK_SW(err, SW_OK, "err");

        // Verify ... on opposite platform
        PRINTF("\n(Host)ECDSA_verify API with eccKeyTls[i] (verify signature created on A71CH).\n");
        memset(&mechInfo, 0, sizeof(mechInfo));
        mechInfo.mechanism = HLSE_ECDSA_VERIFY;
        retcode = HLCRYPT_Verify(&mechInfo,(U8 *)eccKeyTls[i],0,hashSha256,hashSha256Len,signature,signatureLen);
        if (retcode == HLSE_SW_OK)
        {
            PRINTF("Verification OK for eccKeyTls[i].\n");
        }
        else
        {
            PRINTF("Return value: %d, Verification Not OK for eccKeyTls[i]. Test Failed!\n", retcode);
            result &= 0;
            break;
        }
    }

    // Erase the keypair at index 0 & verify the value is no longer readable
    // ** Erase **
    kpIndex = A71CH_KEY_PAIR_0;
    PRINTF("\nA71_EraseEccKeyPair(index=0x%02X)\n", kpIndex);
    err = A71_EraseEccKeyPair(kpIndex);
    result &= AX_CHECK_SW(err, SW_OK, "err");
    // ** Check whether erase was effective **
    PRINTF("\nA71_GetPublicKeyEccKeyPair (index=0x%02X)\n", kpIndex);
    fetchedPubKeyLen = sizeof(fetchedPubKey);
    err = A71_GetPublicKeyEccKeyPair ((SST_Index_t)kpIndex, fetchedPubKey, &fetchedPubKeyLen);
    result &= AX_CHECK_SW(err, SW_CONDITIONS_NOT_SATISFIED, "Get Public Ecc Key was supposed to fail");

    // Now disable the plain insertion/reading out of Symmetric keys & Keypairs
    PRINTF("\nA71_InjectLock()\n");
    err = A71_InjectLock();
    result &= AX_CHECK_SW(err, SW_OK, "err");
    assert(result);

    // Check whether the plain inject has been disabled (check only first key pair)
    PRINTF( "\nA71_SetEccKeyPair(0x%02x)\n", kpIndex);
    err = A71_SetEccKeyPair((SST_Index_t)kpIndex, eccKcAlt.pub, eccKcAlt.pubLen, eccKcAlt.priv, eccKcAlt.privLen);
    result &= AX_CHECK_SW(err, SW_COMMAND_NOT_ALLOWED, "Expected to fail, frozen credential cannot be overwritten");

    // Put back the original (reference) value in the first slot, now first wrap private key on host
    wrappedPrivKeyLen = sizeof(wrappedPrivKey);
    PRINTF("\nHOSTCRYPTO_AesWrapKeyRFC3394(0x%02X)\n", (SST_Index_t)kpIndex);
    err = HOSTCRYPTO_AesWrapKeyRFC3394(configKeyPrivateKey, sizeof(configKeyPrivateKey),
        wrappedPrivKey, &wrappedPrivKeyLen, eccKcTls[kpIndex].priv, eccKcTls[kpIndex].privLen);
    result &= AX_CHECK_SW(err, SW_OK, "err");
    axPrintByteArray("wrappedPrivKey", wrappedPrivKey, wrappedPrivKeyLen, AX_COLON_32);

    PRINTF( "\nA71_SetEccKeyPair(0x%02X)\n", (SST_Index_t)kpIndex);
    err = A71_SetEccKeyPair((SST_Index_t) kpIndex, eccKcTls[kpIndex].pub, eccKcTls[kpIndex].pubLen,
        wrappedPrivKey, wrappedPrivKeyLen);
    result &= AX_CHECK_SW(err, SW_OK, "err");

    // Check all keys are still fine by doing a sign/verify operation
    for (i=0; i<A71CH_KEY_PAIR_MAX; i++)
    {
        signatureLen = sizeof(signature);
        if (appletVersion >= 0x0130)
        {
            PRINTF("\nA71_EccSign(0x%02X)\n", (SST_Index_t)i);
            err = A71_EccSign((SST_Index_t)i, hashSha256, hashSha256Len, signature, &signatureLen);
        }
        else
        {
            PRINTF("\nA71_EccSign(0x%02X)\n", (SST_Index_t)i);
            err = A71_EccSign((SST_Index_t)i, hashSha256, hashSha256Len, signature, &signatureLen);
        }
        result &= AX_CHECK_SW(err, SW_OK, "err");

        // Verify ... on opposite platform
        PRINTF("\n(Host)ECDSA_verify API with eccKeyTls[i] (verify signature created on A71CH).\n");
        memset(&mechInfo, 0, sizeof(mechInfo));
        mechInfo.mechanism = HLSE_ECDSA_VERIFY;
        retcode = HLCRYPT_Verify(&mechInfo,(U8 *)eccKeyTls[i],0,hashSha256,hashSha256Len,signature,signatureLen);
        if (retcode == HLSE_SW_OK)
        {
            PRINTF("Verification OK for eccKeyTls[i].\n");
        }
        else
        {
            PRINTF("Return value: %d, Verification Not OK for eccKeyTls[i]. Test Failed!\n", retcode);
            result &= 0;
            break;
        }
    }

    // Check whether the plain inject has been disabled (for all key pair)
    for (kpIndex=0; kpIndex<A71CH_KEY_PAIR_MAX; kpIndex++)
    {
        PRINTF( "\nA71_SetEccKeyPair(0x%02X)\n", (SST_Index_t)kpIndex);
        err = A71_SetEccKeyPair((SST_Index_t) kpIndex, eccKcTls[kpIndex].pub, eccKcTls[kpIndex].pubLen,
            eccKcTls[kpIndex].priv, eccKcTls[kpIndex].privLen);
        result &= AX_CHECK_SW(err, SW_COMMAND_NOT_ALLOWED, "err");
    }

    // Check whether GenerateKeyPair - without challenge/response - fails
    for (kpIndex=0; kpIndex<A71CH_KEY_PAIR_MAX; kpIndex++)
    {
        PRINTF( "\nA71_GenerateEccKeyPair(0x%02X)\n", (SST_Index_t)kpIndex);
        err = A71_GenerateEccKeyPair((SST_Index_t) kpIndex);
        result &= AX_CHECK_SW(err, SW_COMMAND_NOT_ALLOWED, "err");
    }

    // Do a GenerateKeyPair with challenge response
    for (kpIndex=0; kpIndex<A71CH_KEY_PAIR_MAX; kpIndex++)
    {
        PRINTF( "\nA71_GenerateEccKeyPairWithChallenge(0x%02X)\n", (SST_Index_t)kpIndex);
        err = A71_GenerateEccKeyPairWithChallenge((SST_Index_t) kpIndex, configKeyPrivateKey, sizeof(configKeyPrivateKey));
        result &= AX_CHECK_SW(err, SW_OK, "err");
    }

    //!< \todo Extend example program to check whether there's a new keypair inside A71CH

    // Check whether EraseKeyPair - without challenge/response - fails
    for (kpIndex=0; kpIndex<A71CH_KEY_PAIR_MAX; kpIndex++)
    {
        PRINTF( "\nA71_EraseEccKeyPair(0x%02X)\n", (SST_Index_t)kpIndex);
        err = A71_EraseEccKeyPair((SST_Index_t) kpIndex);
        result &= AX_CHECK_SW(err, SW_WRONG_DATA, "err");
    }

    // Do a EraseKeyPair with challenge response
    for (kpIndex=0; kpIndex<A71CH_KEY_PAIR_MAX; kpIndex++)
    {
        PRINTF( "\nA71_EraseEccKeyPairWithChallenge(0x%02X)\n", (SST_Index_t)kpIndex);
        err = A71_EraseEccKeyPairWithChallenge((SST_Index_t) kpIndex, configKeyPrivateKey, sizeof(configKeyPrivateKey));
        result &= AX_CHECK_SW(err, SW_OK, "err");
    }

    // Check whether reading out public key from erased keypairs now fails.
    for (kpIndex=0; kpIndex<A71CH_KEY_PAIR_MAX; kpIndex++)
    {
        PRINTF("\nA71_GetPublicKeyEccKeyPair (index=0x%02X)\n", kpIndex);
        fetchedPubKeyLen = sizeof(fetchedPubKey);
        err = A71_GetPublicKeyEccKeyPair ((SST_Index_t)kpIndex, fetchedPubKey, &fetchedPubKeyLen);
        result &= AX_CHECK_SW(err, SW_CONDITIONS_NOT_SATISFIED, "Get Public Ecc Key was supposed to fail");
    }

    for (i=0; i<A71CH_KEY_PAIR_MAX; i++)
    {
        HOSTCRYPTO_FreeEccKey(&eccKeyTls[i]);
    }

    PRINTF( "\n-----------\nEnd exSstKeyPairEnc(%s), result = %s\n------------\n", getInitModeAsString(initMode),
        ((result == 1)? "OK": "FAILED"));

    return result;
}
```
